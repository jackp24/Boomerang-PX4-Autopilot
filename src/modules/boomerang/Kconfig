## src/modules/boomerang/Kconfig
```kconfig
menuconfig MODULES_BOOMERANG
	bool "boomerang controller"
	default n
	---help---
		Boomerang custom control module
```

## src/modules/boomerang_estimator/Kconfig
```kconfig
menuconfig MODULES_BOOMERANG_ESTIMATOR
    bool "boomerang_estimator"
    default n
    ---help---
        Boomerang companion estimator. Publishes vehicle_attitude_virtual,
        despun vehicle_angular_velocity, and boomerang_azimuth.
```

## src/modules/heading_led/Kconfig
```kconfig
menuconfig MODULES_HEADING_LED
    bool "heading_led"
    default n
    ---help---
        Enable the heading LED indicator module.
```
